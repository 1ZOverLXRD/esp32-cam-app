## sdkconfig.defaults
```kconfig
# ESP32-CAM Optimization — sdkconfig overrides
# Applied on top of sdkconfig; run `idf.py reconfigure` to apply

# --- CPU & Compiler ---
CONFIG_COMPILER_OPTIMIZATION_PERF=y
CONFIG_COMPILER_OPTIMIZATION_ASSERTIONS_DISABLE=y

# --- PSRAM (8MB Octal @80MHz) ---
CONFIG_SPIRAM_FETCH_INSTRUCTIONS=y
CONFIG_SPIRAM_RODATA=y
CONFIG_SPIRAM_SPEED_80M=y
CONFIG_SPIRAM_MALLOC_ALWAYSINTERNAL=0
CONFIG_SPIRAM_TRY_ALLOCATE_WIFI_LWIP=y

# --- Camera DMA in PSRAM (ESP32-S3 必要) ---
CONFIG_CAMERA_PSRAM_DMA=y

# --- Instruction Cache 32KB (默认16KB，LVGL+Camera+WiFi 代码密集) ---
CONFIG_ESP32S3_INSTRUCTION_CACHE_32KB=y

# --- Data Cache ---
CONFIG_ESP32S3_DATA_CACHE_64KB=y
CONFIG_ESP32S3_DATA_CACHE_LINE_64B=y

# --- Flash (DIO, 16MB — 匹配 ESP32-S3 N16) ---
CONFIG_ESPTOOLPY_FLASHMODE_DIO=y
CONFIG_ESPTOOLPY_FLASHSIZE_16MB=y

# --- WiFi (AP+STA mode) ---
CONFIG_ESP_WIFI_DYNAMIC_RX_BUFFER_NUM=16
CONFIG_ESP_WIFI_CACHE_TX_BUFFER_NUM=16
CONFIG_ESP_WIFI_SOFTAP_BEACON_MAX_LEN=256
CONFIG_ESP_WIFI_TX_BA_WIN=6

# --- LVGL (v8.4.0) ---
CONFIG_LV_CONF_SKIP=y
CONFIG_LV_FONT_SIMSUN_16_CJK=y

# --- 关闭 PSRAM 启动内存测试（省 ~1s 启动时间） ---
CONFIG_SPIRAM_MEMTEST=n
```
